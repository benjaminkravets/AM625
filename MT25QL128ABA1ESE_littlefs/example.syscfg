/**
 * @cliArgs --device "AM62x" --part "Default" --package "AMC" --context "a53ss0-0" --product "MCU_PLUS_SDK_AM62x@11.00.00"
 * @versions {"tool":"1.23.0+4000"}
 */

/**
 * Import the modules used in this configuration.
 */
const i2c        = scripting.addModule("/drivers/i2c/i2c", {}, false);
const i2c1       = i2c.addInstance();
const mcspi      = scripting.addModule("/drivers/mcspi/mcspi", {}, false);
const mcspi1     = mcspi.addInstance();
const debug_log  = scripting.addModule("/kernel/dpl/debug_log");
const mmu_armv8  = scripting.addModule("/kernel/dpl/mmu_armv8", {}, false);
const mmu_armv81 = mmu_armv8.addInstance();
const mmu_armv82 = mmu_armv8.addInstance();
const mmu_armv83 = mmu_armv8.addInstance();

/**
 * Write custom configuration values to the imported modules.
 */
i2c1.$name           = "CONFIG_I2C1_TCA";
i2c1.enableIntr      = false;
i2c1.I2C.$assign     = "I2C1";
i2c1.I2C_child.$name = "drivers_i2c_v0_i2c_v0_template0";

mcspi1.$name                 = "CONFIG_MCSPI2";
mcspi1.SPI.$assign           = "SPI0";
mcspi1.mcspiChannel[0].$name = "CONFIG_MCSPI_CH0";

debug_log.enableUartLog            = true;
debug_log.uartLog.$name            = "CONFIG_UART0";
debug_log.uartLog.UART.$assign     = "USART0";
debug_log.uartLog.UART.RXD.$assign = "UART0_RXD";
debug_log.uartLog.UART.TXD.$assign = "UART0_TXD";

mmu_armv81.size  = 0x80000000;
mmu_armv81.$name = "SOC_MEM_REGION";

mmu_armv82.$name             = "ATF_REGION";
mmu_armv82.vAddr             = 0x80000000;
mmu_armv82.pAddr             = 0x80000000;
mmu_armv82.size              = 0x80000;
mmu_armv82.accessPermissions = "Privilege RO, User None";
mmu_armv82.shareable         = "Non Shareable";

mmu_armv83.size      = 0x80000000;
mmu_armv83.attribute = "MAIR7";
mmu_armv83.$name     = "DDR_REGION";
mmu_armv83.vAddr     = 0x80080000;
mmu_armv83.pAddr     = 0x80080000;

/**
 * Pinmux solution for unlocked pins/peripherals. This ensures that minor changes to the automatic solver in a future
 * version of the tool will not impact the pinmux you originally saw.  These lines can be completely deleted in order to
 * re-solve from scratch.
 */
i2c1.I2C.SCL.$suggestSolution               = "I2C1_SCL";
i2c1.I2C.SDA.$suggestSolution               = "I2C1_SDA";
mcspi1.SPI.CLK.$suggestSolution             = "SPI0_CLK";
mcspi1.SPI.D0.$suggestSolution              = "SPI0_D0";
mcspi1.SPI.D1.$suggestSolution              = "SPI0_D1";
mcspi1.mcspiChannel[0].CSn.$suggestSolution = "SPI0_CS0";
